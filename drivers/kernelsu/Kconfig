## drivers/kernelsu/Kconfig
```kconfig
menu "KernelSU"

config KSU
	tristate "KernelSU function support"
	default n
	help
	  Enable kernel-level root privileges on Android System.

	  To compile as a module, choose M here: the
	  module will be called kernelsu.

endmenu
```
